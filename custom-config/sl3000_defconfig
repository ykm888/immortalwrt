## custom-config/sl3000_defconfig
```kconfig
CONFIG_TARGET_mediatek=y
CONFIG_TARGET_mediatek_filogic=y
CONFIG_TARGET_mediatek_filogic_DEVICE_sl3000-emmc=y
# 针对 1GB 运行内存的优化
CONFIG_PACKAGE_kmod-zram=y
CONFIG_PACKAGE_zram-swap=y
# 针对 128GB 存储的扩容支持
CONFIG_PACKAGE_f2fs-tools=y
CONFIG_PACKAGE_parted=y
```
